## code/cloud-kernel-6.6.102-6/arch/arm64/kvm/hisilicon/Kconfig
```kconfig
# SPDX-License-Identifier: GPL-2.0-only
config KVM_HISI_VIRT
	bool "HiSilicon SoC specific virtualization features"
	depends on ARCH_HISI
	depends on KVM
	help
	  Support for HiSilicon SoC specific virtualization features.
	  On non-HiSilicon platforms, say N here.

config ARM64_HISI_IPIV
	bool "Enable support for IPIV"
	default y
	depends on ACPI
	depends on KVM_HISI_VIRT
	help
	  IPIV optimizes vSGI on the basis of GICv4.1. The vCPU on the sending
	  side of vSGI needs to trap to Hypervisor. IPIv sends vSGI without
	  traping, improving performance.

	  The feature will only be enabled if CPU in the system and Guest OS
	  support this feature. If unsure, say Y.
```

## code/cloud-kernel-6.6.102-6/drivers/gpu/drm/yhgch/yhgch-drm/Kconfig
```kconfig
config DRM_YHGCH
	tristate "DRM Support for YHGCH BMC"
	depends on DRM && PCI && MMU
	select DRM_KMS_HELPER
	select DRM_VRAM_HELPER
	help
	  Choose this option if you have a Yhgch soc chipset.
	  If M is selected the module will be called yhgch-drm.
```

## 源码/cloud-kernel-6.6.102-6/drivers/clk/sophgo/Kconfig
```kconfig
# SPDX-License-Identifier: GPL-2.0
# common clock support for SOPHGO SoC family.

config CLK_SOPHGO_SG2042_PLL
	tristate "Sophgo SG2042 PLL clock support"
	depends on ARCH_SOPHGO || COMPILE_TEST
	help
	  This driver supports the PLL clock controller on the
	  Sophgo SG2042 SoC. This clock IP uses three oscillators with
	  frequency of 25 MHz as input, which are used for Main/Fixed
	  PLL, DDR PLL 0 and DDR PLL 1 respectively.

config CLK_SOPHGO_SG2042_CLKGEN
	tristate "Sophgo SG2042 Clock Generator support"
	depends on CLK_SOPHGO_SG2042_PLL
	help
	  This driver supports the Clock Generator on the
	  Sophgo SG2042 SoC. This clock IP depends on SG2042 PLL clock
	  because it uses PLL clocks as input.
	  This driver provides clock function such as DIV/Mux/Gate.

config CLK_SOPHGO_SG2042_RPGATE
	tristate "Sophgo SG2042 RP subsystem clock controller support"
	depends on CLK_SOPHGO_SG2042_CLKGEN
	help
	  This driver supports the RP((Riscv Processors)) subsystem clock
	  controller on the Sophgo SG2042 SoC.
	  This clock IP depends on SG2042 Clock Generator because it uses
	  clock from Clock Generator IP as input.
	  This driver provides Gate function for RP.
```

## 源码/cloud-kernel-6.6.102-6/drivers/gpu/drm/yhgch/Kconfig
```kconfig
# License: GPL-2.0
#
# yhgch drm device configuration.

source "drivers/gpu/drm/yhgch/yhgch-drm/Kconfig"
```

## 源码/cloud-kernel-6.6.102-6/drivers/pinctrl/sophgo/Kconfig
```kconfig
# SPDX-License-Identifier: GPL-2.0-only
#
# Sophgo SoC PINCTRL drivers
#

config PINCTRL_SOPHGO_COMMON
	tristate
	select GENERIC_PINCTRL_GROUPS
	select GENERIC_PINMUX_FUNCTIONS
	select GENERIC_PINCONF

config PINCTRL_SOPHGO_SG2042_OPS
	bool

config PINCTRL_SOPHGO_SG2042
	tristate "Sophgo SG2042 SoC Pinctrl driver"
	depends on ARCH_SOPHGO || COMPILE_TEST
	depends on OF
	select PINCTRL_SOPHGO_COMMON
	select PINCTRL_SOPHGO_SG2042_OPS
	help
	  Say Y to select the pinctrl driver for SG2042 SoC.
	  This pin controller allows selecting the mux function for
	  each pin. This driver can also be built as a module called
	  pinctrl-sg2042.
```
